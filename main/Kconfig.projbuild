## main/Kconfig.projbuild
```kconfig
menu "Configuration"

    config CHANNEL
        int "Max size of scan list"
        range 0 20
        default 10
        help
            The size of array that will be used to retrieve the list of access points.

endmenu
```
